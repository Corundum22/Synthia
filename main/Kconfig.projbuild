## main/Kconfig.projbuild
```kconfig
menu "Pin Configuration"
    menu "SPI Pins"
        # SPI pin mapping is only configurable on the ESP32-S3
        visible if IDF_TARGET_ESP32S3
        config SPI_MISO
            int "MISO pin"
            default 19 if IDF_TARGET_ESP32
        config SPI_MOSI
            int "MOSI pin"
            default 23 if IDF_TARGET_ESP32
        config SPI_CLOCK
            int "Clock pin"
            default 18 if IDF_TARGET_ESP32
    endmenu

    menu "TFT Pins"
        config TFT_CS_PIN
            int
            default 5 if IDF_TARGET_ESP32

        config TFT_RESET_PIN
            int
            default 4 if IDF_TARGET_ESP32
    
        config TFT_DC_PIN
            int
            default 22 if IDF_TARGET_ESP32

        config TFT_BACKLIGHT_PIN
            int
            default -1 if IDF_TARGET_ESP32
    endmenu
endmenu

choice DISPLAY_COLOR_MODE
    bool "Color Mode"
    default DISPLAY_COLOR_MODE_BGR
    config DISPLAY_COLOR_MODE_BGR
        bool "Blue,Green,Red"
    config DISPLAY_COLOR_MODE_RGB
        bool "Red,Green,Blue"
endchoice

config DISPLAY_COLOR_MODE
    int
    default 1 if DISPLAY_COLOR_MODE_BGR
    default 0 if DISPLAY_COLOR_MODE_RGB
```
